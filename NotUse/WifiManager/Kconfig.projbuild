## NotUse/WifiManager/Kconfig.projbuild
```kconfig
menu "WiFi Config Menu"

    config SSID
        string  "SSID"
        default "SPARC_LAB"
        help
            SSID.

    config PASSWORD
        string  "PASSWORD"
        default  "123456"
        help 
            PASSWORD.

    config MAXIMUM_RETRY
        int "Maximum retry"
        default 25
        help
            Set the Maximum retry to avoid station reconnecting to the AP unlimited when the AP is really inexistent.

endmenu
```

## component/BME280/Kconfig.projbuild
```kconfig
menu "BME configuration"
    config BME_PIN_NUM_SCL
        int "SCL GPIO Number"
        default 27
        help
            GPIO number for I2C Master clock line.

    config BME_PIN_NUM_SDA
        int "SDA GPIO Number"
        default 26
        help
            GPIO number for I2C Master data line.

    config BME_I2C_PORT
        int "I2C Port"
        default 1
        help 
            I2C port for BME280 sensor.

    config BME_I2C_FREQ_HZ
        int "Frequency I2C"
        default 400000
        help
            I2C frequency.

endmenu
```

## component/FileManager/Kconfig.projbuild
```kconfig
menu "SD Card menu"

    config PIN_NUM_MOSI
        int "MOSI GPIO Number"
        default 19
        help
            GPIO number for SPI master MOSI.

    config PIN_NUM_MISO
        int "MISO GPIO Number"
        default 21
        help
            GPIO number for SPI master MISO.

    config PIN_NUM_CLK
        int "CLK GPIO Number"
        default 18
        help
            GPIO number for SPI master CLK.

    config PIN_NUM_CS
        int "CS GPIO Number"
        default 5
        help
            GPIO number for SPI master CS.
            
endmenu
```

## component/LCD_TFT_driver/Kconfig.projbuild
```kconfig
menu "LCD TFT configuration"

      config USING_LCD_TFT
        bool "Using LCD TFT"
        default n
        help 
            Using LCD TFT.

    config LCD_PIN_NUM_MOSI
        int "MOSI GPIO Number"
        default 12
        help
            GPIO number for SPI master MOSI.

    config LCD_PIN_NUM_MISO
        int "MISO GPIO Number"
        default 13
        help
            GPIO number for SPI master MISO.

    config LCD_PIN_NUM_SCK
        int "SCK GPIO Number"
        default 14
        help
            GPIO number for SPI master CLK.

    config LCD_PIN_NUM_CS
        int "CS GPIO Number"
        default 2
        help
            GPIO number for SPI master CS.       

     config LCD_PIN_NUM_BK_LIGHT
        int "Backlight GPIO Number"
        default 4
        help
            GPIO number for controlling backlight of LCD TFT.      

    config LCD_PIN_NUM_DC
        int "DC GPIO Number"
        default 1
        help
            GPIO number for DC pin of LCD TFT.   
    
     config LCD_PIN_NUM_RST
        int "RST GPIO Number"
        default 15
        help
            GPIO number for reset LCD TFT. 
endmenu
```

## component/MHZ14a/Kconfig.projbuild
```kconfig
menu "MHZ14a configuration"

    config MHZ14A_PWM_PIN
        int "PMW PIN GPIO Number"
        default 32
        help
            GPIO number for PWM PIN.

    config QUEUE_SIZE
        int "Max size queue"
        default 1
        help
            Max size queue for store capture PWM.

    config HD_PIN
        int "HD PIIN GPIO number"
        default 33
        help 
            GPIO number for HD PIN, using for zero-point calibration(auto calibartion).

    choice MHZ14A_PROTOCOL_COMMUNICATION
        prompt "MHZ14a protocol"
        default MHZ14A_PWM
        help
            MHZ14a protocol communication to get data.

        config MHZ14A_PWM
            bool "PWM"
            default 1
        config MHZ14A_UART
            bool "UART"
            default 0

        
    endchoice

    menu "MHZ14a UART configuration"
        depends on MHZ14A_UART

        config MHZ14A_PIN_TX
            int "TX GPIO Number"
            default 1
            help
                GPIO number for TX.
        
        config MHZ14A_PIN_RX
            int "RX GPIO Number"
            default 3
            help
                GPIO number for RX.
        
        config MHZ14A_UART_BAUD_RATE
            int "UART baudrate"
            default 9600
            help
                UART baudrate.
        
        config MHZ14A_UART_PORT
            int "Uart Port"
            default 0
            help 
                UART port for PMS sensor.
        
    endmenu
endmenu
```

## component/OTA/Kconfig.projbuild
```kconfig
menu "Update OTA Configuration"

    config UPDATE_JSON_URL
        string "JSON Firmware information URL"
        default "http://192.168.1.124:9001/api/get/version"
        help
            URL of server which give you information about firmware that it hosting.

    config FIRMWARE_UPGRADE_URL
        string "Firmware Upgrade URL"
        default "http://192.168.1.124:9001/api/get/dataFile"
        help
            URL of server which hosts the firmware image.

    config FIRMWARE_UPGRADE_URL_FROM_STDIN
        bool
        default y if FIRMWARE_UPGRADE_URL = "FROM_STDIN"

    config SKIP_VERSION_CHECK
        bool "Skip firmware version check"
        default n
        help
            This allows you to skip the firmware version check.

    config OTA_RECV_TIMEOUT
        int "OTA Receive Timeout"
        default 15000
        help
            Maximum time for reception

    config TIME_INTERVAL_UPDATE
        int "Interval between check OTA times (in second)"
        default 30
        help
            Interval between check OTA times (in second).

    config ENABLE_PARTIAL_HTTP_DOWNLOAD
        bool "Enable partial HTTP download"
        default n
        help
            This enables use of Range header in esp_https_ota component.
            Firmware image will be downloaded over multiple HTTP requests.

    config HTTP_REQUEST_SIZE
        int "HTTP request size"
        default MBEDTLS_SSL_IN_CONTENT_LEN
        depends on ENABLE_PARTIAL_HTTP_DOWNLOAD
        help
            This options specifies HTTP request size. Number of bytes specified
            in this option will be downloaded in single HTTP request.


endmenu
```

## component/PMS7003/Kconfig.projbuild
```kconfig
menu "PMS7003 configuration"

    config PMS_PIN_TX
        int "TX GPIO Number"
        default 17
        help
            GPIO number for TX.

    config PMS_PIN_RX
        int "RX GPIO Number"
        default 16
        help
            GPIO number for RX.

    config UART_BAUD_RATE
        int "UART baudrate"
        default 9600
        help
            UART baudrate.

    config PMS_UART_PORT
        int "Uart Port"
        default 2
        help 
            UART port for PMS sensor.


endmenu
```

## component/Time/Kconfig.projbuild
```kconfig
menu "RTC configuration"

    config RTC_PIN_NUM_SCL
        int "SCL GPIO Number"
        default 27 if IDF_TARGET_ESP32 || IDF_TARGET_ESP32S2 || IDF_TARGET_ESP32S3
        help
            GPIO number for I2C Master clock line.

    config RTC_PIN_NUM_SDA
        int "SDA GPIO Number"
        default 26 if IDF_TARGET_ESP32 || IDF_TARGET_ESP32S2 || IDF_TARGET_ESP32S3
        help
            GPIO number for I2C Master data line.

    config RTC_I2C_PORT
        int "I2C Port"
        default 0
        help 
            I2C port for RTC module.

    config RTC_I2C_FREQ_HZ
        int "Frequency I2C"
        default 400000
        help
            I2C frequency.

endmenu
```

## main/Kconfig.projbuild
```kconfig
menu "Device in use" 

    config NAME_DEVICE
        string "Name Device"
        default "ESP32-Project"
        help
            Name device.

    config FIRMWARE_VERSION
        string "Firmware version"
        default "1.0.1"
        help 
            Firmware version.

    config USING_WIFI
        bool "Using WIFI station"
        default y
        help 
            Using connect WIFI.

    config USING_SDCARD
        bool "Using SD card"
        default y
        help 
            Using SD card for store data.

    config USING_RTC
        bool "Using RTC module(DS3231)"
        default y
        help 
            Using DS3231 module.

    config RTC_TIME_SYNC
        bool "Time synchronization for RTC"
        default y
        help 
            Time synchronization for RTC

    config USING_BME280
        bool "Using BME280 Sensor"
        default y
        help 
            Using BME280 sensor.

    config USING_SDS011
        bool "Using SDS011 Sensor"
        default n
        help 
            Using SDS011 Sensor.

    config USING_PMS7003
        bool "Using PMS7003 Sensor"
        default y
        help 
            Using PMS7003 Sensor.

    config USING_O3_SENSOR
        bool "Using O3 Sensor"
        default n
        help 
            Using O3 Sensor.

    config USING_CO_SENSOR
        bool "Using CO Sensor"
        default n
        help 
            Using CO Sensor.

    config USING_CO2_SENSOR
        bool "Using CO2 Sensor"
        default n
        help 
            Using CO2 Sensor.

    config USING_NO2_SENSOR
        bool "Using NO2 Sensor"
        default n
        help 
            Using NO2 Sensor.

            

endmenu

menu "WIFI Configuration"

    config SSID
        string  "SSID"
        default "Active Learn"
        help
            SSID.

    config PASSWORD
        string  "PASSWORD"
        default  "123"
        help 
            PASSWORD.

    config MAXIMUM_AP
        int "Maximum access points"
        default  10
        help 
            Maximum access points.

    config MAXIMUM_RETRY
        int "Maximum retry"
        default 20
        help
            Set the Maximum retry to avoid station reconnecting to the AP unlimited when the AP is really inexistent.

    config SHOW_LIST_ACCESS_POINTS_FOUND
        bool "Show list Access Points found."
        default y
        help
            Show list Access Points found.

endmenu

menu "MQTT Configuration"

    config BROKER_URI
        string "Broker URL"
        default "mqtt://103.1.238.175:1885"
        help
            URL of an mqtt broker which this device connects to.

    config BROKER_HOST
        string "Broker host"
        default "103.1.238.175"
        help 
            Host is MQTT server domain <ipv4 as string>

    config BROKER_PORT
        int "Broker port"
        default 1885
        help 
            Port is MQTT server port

    config MQTT_USERNAME
        string "User name"
        default "test"
        help 
            MQTT username

    config MQTT_PASSWORD
        string  "Password"
        default  "testadmin"
        help 
            MQTT password

    config MQTT_TOPIC
        string "MQTT topic"
        default "PROJECT_VIEWDATA"
        help
            Topic to subcrice

    config MQTT_CLIENT_ID
        string "Client ID"
        default "ESP32-Project"
        help
            Set MQTT client identifier.

    config MQTT_TIMEOUT
        int "MQTT Timeout in ms"
        default 10000
        help
            Abort network operation if it is not completed after this value, in milliseconds.

    config MQTT_DISABLE_AUTO_RECONNECT
        bool "Disable auto reconnect to server"
        default n
        help
            Client will reconnect to server (when errors/disconnect).

   

    config BROKER_CERTIFICATE_OVERRIDDEN
        bool
        default y if BROKER_CERTIFICATE_OVERRIDE != ""

  

endmenu
menu "Get Data Period"
    config GET_DATA_PERIOD
        int "Period to get data in seconds"
        default 5
        help
            The interval to read data from sensors and send to queue
endmenu

menu "OTA Configuration"
    config USING_FIRMWARE_UPDATE_BY_OTA
        bool "Using firmware update by OTA"
        default n
        help 
            Using firmware update by OTA.

    config FIRMWARE_UPDATE_URL
        string "Firmware Update URL"
        default "https://192.168.2.106:8070/hello_world.bin"
        help
            URL of server which hosts the firmware image.

    config EXAMPLE_OTA_RECV_TIMEOUT
        int "OTA Receive Timeout"
        default 5000
        help
            Maximum time for reception

    config API_KEY
        string "API update key"
        default "AIRSENSE_ESP32_PROJECT"
        help 
            API key to request new firmware
endmenu
```
